/ {
    compatible = "zmk,keyboard";

    kscan {
        compatible = "zmk,kscan-gpio-matrix";
        row-gpios = < 
            &gpio0 4 
            &gpio0 15 
            &gpio0 9 
            &gpio0 8 
            &gpio0 7 
        >;
        col-gpios = < 
            &gpio0 21 
            &gpio0 10 
            &gpio0 16 
            &gpio0 14 
            &gpio0 20 
            &gpio0 19 
            &gpio0 6 
        >;
        diode-direction = <ROW2COL>;
    };
};
